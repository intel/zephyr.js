## CMakeLists.txt
```
# Copyright (c) 2017, Intel Corporation.

cmake_minimum_required(VERSION 3.8.2)

if(NOT DEFINED ENV{ZEPHYR_BASE})
  message(FATAL_ERROR "Missing Zephyr base, did you source zephyr-env.sh?")
endif()
set(ZEPHYR_BASE $ENV{ZEPHYR_BASE})

include($ENV{ZEPHYR_BASE}/cmake/app/boilerplate.cmake NO_POLICY_SCOPE)
project(NONE)

# Work-around that replaces -O2 with -Os to shrink build size
# remove this patch when Zephyr updates to revert
# back to -Os in upstream
if(NOT "${VARIANT}" STREQUAL "debug")
  zephyr_get_compile_options_for_lang_as_string(C options)
  string(REPLACE "-O2" "-Os" options_new ${options})
  separate_arguments(options_new)
  zephyr_compile_options(${options_new})
endif()

target_compile_options(app PRIVATE -Wall)

target_include_directories(app PRIVATE ${CMAKE_SOURCE_DIR}/../src)
target_include_directories(app PRIVATE ${ZEPHYR_BASE}/drivers)

target_sources(app PRIVATE src/main.c)

include(${CMAKE_BINARY_DIR}/generated.cmake)
```

## prj.conf
```kconfig
CONFIG_STDOUT_CONSOLE=y
CONFIG_PRINTK=y
CONFIG_IPM=y
CONFIG_IPM_QUARK_SE=y
CONFIG_IPM_CONSOLE_SENDER=y
CONFIG_CONSOLE=y
CONFIG_SERIAL=n
CONFIG_NS16550=n
CONFIG_NANO_TIMEOUTS=y
CONFIG_ADC=y
CONFIG_ADC_DW=y
CONFIG_ADC_DW_REPETITIVE=y
CONFIG_I2C=y
CONFIG_GROVE=y
CONFIG_GROVE_LCD_RGB=y
CONFIG_GROVE_LCD_RGB_INIT_PRIORITY=90
CONFIG_FLASH_BASE_ADDRESS=0x40050000
```

## src/main.c
```c
// Copyright (c) 2016-2017, Intel Corporation.

// C includes
#include <string.h>

// Zephyr includes
#include <zephyr.h>
#ifdef BUILD_MODULE_AIO
#include <adc.h>
#endif

// ZJS includes
#include "arc_common.h"
#ifdef BUILD_MODULE_AIO
#include "arc_aio.h"
#endif
#ifdef BUILD_MODULE_GROVE_LCD
#include "arc_grove_lcd.h"
#endif
#ifdef BUILD_MODULE_I2C
#include "arc_i2c.h"
#endif
#ifdef BUILD_MODULE_PME
#include "arc_pme.h"
#endif
#ifdef BUILD_MODULE_SENSOR
#include "arc_sensor.h"
#endif

#define AIO_UPDATE_INTERVAL 200  // 2sec interval in between notifications
#define QUEUE_SIZE 10            // max incoming message can handle
#define SLEEP_TICKS 1            // 10ms sleep time in cpu ticks

static struct k_sem arc_sem;

#ifdef CONFIG_IPM
static struct zjs_ipm_message msg_queue[QUEUE_SIZE];
static struct zjs_ipm_message *end_of_queue_ptr = msg_queue + QUEUE_SIZE;

int ipm_send_msg(struct zjs_ipm_message *msg)
{
    msg->flags &= ~MSG_ERROR_FLAG;
    msg->error_code = ERROR_IPM_NONE;
    return zjs_ipm_send(msg->id, msg);
}

int ipm_send_error(struct zjs_ipm_message *msg, u32_t error_code)
{
    msg->flags |= MSG_ERROR_FLAG;
    msg->error_code = error_code;
    DBG_PRINT("send error %u\n", msg->error_code);
    return zjs_ipm_send(msg->id, msg);
}

static void queue_message(struct zjs_ipm_message *incoming_msg)
{
    struct zjs_ipm_message *msg = msg_queue;

    if (!incoming_msg) {
        return;
    }

    k_sem_take(&arc_sem, K_FOREVER);
    while (msg && msg < end_of_queue_ptr) {
        if (msg->id == MSG_ID_DONE) {
            break;
        }
        msg++;
    }

    if (msg != end_of_queue_ptr) {
        // copy the message into our queue to be process in the mainloop
        *msg = *incoming_msg;
    } else {
        // running out of space, disregard message
        ERR_PRINT("skipping incoming message\n");
    }
    k_sem_give(&arc_sem);
}

static void ipm_msg_receive_callback(void *context, u32_t id,
                                     volatile void *data)
{
    struct zjs_ipm_message *incoming_msg =
        (struct zjs_ipm_message *)(*(uintptr_t *)data);
    if (incoming_msg) {
        queue_message(incoming_msg);
    } else {
        ERR_PRINT("message is NULL\n");
    }
}

static void process_messages()
{
    struct zjs_ipm_message *msg = msg_queue;

    while (msg && msg < end_of_queue_ptr) {
        // loop through all messages and process them
        switch (msg->id) {
#ifdef BUILD_MODULE_AIO
        case MSG_ID_AIO:
            arc_handle_aio(msg);
            break;
#endif
#ifdef BUILD_MODULE_I2C
        case MSG_ID_I2C:
            arc_handle_i2c(msg);
            break;
#endif
#ifdef BUILD_MODULE_GROVE_LCD
        case MSG_ID_GLCD:
            arc_handle_glcd(msg);
            break;
#endif
#ifdef BUILD_MODULE_SENSOR
        case MSG_ID_SENSOR:
            arc_handle_sensor(msg);
            break;
#endif
#ifdef BUILD_MODULE_PME
        case MSG_ID_PME:
            arc_handle_pme(msg);
            break;
#endif
        case MSG_ID_DONE:
            return;
        default:
            ERR_PRINT("unsupported ipm message id: %u, check ARC modules\n",
                      msg->id);
            ipm_send_error(msg, ERROR_IPM_NOT_SUPPORTED);
        }

        msg->id = MSG_ID_DONE;
        msg++;
    }
}
#endif

void main(void)
{
    ZJS_PRINT("Sensor core running ZJS ARC support image\n");

    k_sem_init(&arc_sem, 0, 1);
    k_sem_give(&arc_sem);
#ifdef CONFIG_IPM
    memset(msg_queue, 0, sizeof(struct zjs_ipm_message) * QUEUE_SIZE);

    zjs_ipm_init();
    zjs_ipm_register_callback(-1, ipm_msg_receive_callback);  // MSG_ID ignored
#endif
#ifdef BUILD_MODULE_AIO
    arc_aio_init();
#endif

    int tick_count = 0;
    while (1) {
#ifdef CONFIG_IPM
        process_messages();
#endif
#ifdef BUILD_MODULE_AIO
        if (tick_count % AIO_UPDATE_INTERVAL == 0) {
            arc_process_aio_updates();
        }
#endif
#ifdef BUILD_MODULE_SENSOR
        if (tick_count % (u32_t)(CONFIG_SYS_CLOCK_TICKS_PER_SEC /
                                 sensor_poll_freq) == 0) {
            arc_fetch_sensor();
#ifdef BUILD_MODULE_SENSOR_LIGHT
            arc_fetch_light();
#endif
        }
#endif
        tick_count += SLEEP_TICKS;
        k_sleep(SLEEP_TICKS);
    }

#ifdef BUILD_MODULE_AIO
    arc_aio_cleanup();
#endif
}
```

## src/CuriePME.c
```c
// Copyright (c) 2017, Intel Corporation.

#include "CuriePME.h"

static uint16_t nsr_save = 0;

// Default initializer
void CuriePME_begin(void)
{
    uint16_t savedNSR = regRead16(NSR);
    CuriePME_forget();

    regWrite16(NSR, (uint16_t)NSR_NET_MODE);

    for (int i = 0; i < maxNeurons; i++) {
        regWrite16(TESTCOMP, 0);
    }

    regWrite16(TESTCAT, 0);
    regWrite16(NSR, savedNSR);
}

void CuriePME_configure(uint16_t global_context,
                        PATTERN_MATCHING_DISTANCE_MODE distance_mode,
                        PATTERN_MATCHING_CLASSIFICATION_MODE classification_mode,
                        uint16_t minAIF,
                        uint16_t maxAIF)
{
    regWrite16(GCR, (global_context | (distance_mode << 7)));
    regWrite16(NSR, regRead16(NSR) | (classification_mode << 5));
    regWrite16(MINIF, minAIF);
    regWrite16(MAXIF, maxAIF);
}

// clear all commits in the network and make it ready to learn
void CuriePME_forget(void) { regWrite16(FORGET_NCOUNT, 0); }

// mark --learn and classify--

uint16_t CuriePME_learn(uint8_t* pattern_vector,
                        int32_t vector_length,
                        uint16_t category)
{
    if (vector_length > maxVectorSize)
        vector_length = maxVectorSize;

    for (int i = 0; i < vector_length - 1; i++) {
        regWrite16(COMP, pattern_vector[i]);
    }

    regWrite16(LCOMP, pattern_vector[vector_length - 1]);

     // Mask off the 15th bit-- valid categories range from 1-32766,
     // and bit 15 is used to indicate if a firing neuron has degenerated
    regWrite16(CAT, (regRead16(CAT) & ~CAT_CATEGORY) | (category & CAT_CATEGORY));

    return regRead16(FORGET_NCOUNT);
}

uint16_t CuriePME_classify(uint8_t* pattern_vector, int32_t vector_length)
{
    uint8_t* current_vector = pattern_vector;
    uint8_t index = 0;

    if (vector_length > maxVectorSize)
        return -1;

    for (index = 0; index < (vector_length - 1); index++) {
        regWrite16(COMP, current_vector[index]);
    }

    regWrite16(LCOMP, current_vector[vector_length - 1]);
    regRead16(IDX_DIST); // Sort by distance by David Florey

    return (regRead16(CAT) & CAT_CATEGORY);
}

// write vector is used for kNN recognition and does not alter
// the CAT register, which moves the chain along.
uint16_t CuriePME_writeVector(uint8_t* pattern_vector, int32_t vector_length)
{

    uint8_t* current_vector = pattern_vector;
    uint8_t index = 0;

    if (vector_length > maxVectorSize)
        return -1;

    for (index = 0; index < (vector_length - 1); index++) {
        regWrite16(COMP, current_vector[index]);
    }

    regWrite16(LCOMP, current_vector[vector_length - 1]);

    return 0;
}

// retrieve the data of a specific neuron element by ID, between 1 and 128.
uint16_t CuriePME_readNeuron(int32_t neuronID, neuronData* data_array)
{
    uint16_t dummy = 0;

    // range check the ID - technically, this should be an error.

    if (neuronID < firstNeuronID)
        neuronID = firstNeuronID;
    if (neuronID > lastNeuronID)
        neuronID = lastNeuronID;

    // use the beginSaveMode method
    CuriePME_beginSaveMode();

    // iterate over n elements in order to reach the one we want.
    for (int i = 0; i < (neuronID - 1); i++) {
        dummy = regRead16(CAT);
    }

    // retrieve the data using the iterateToSave method
    CuriePME_iterateNeuronsToSave(data_array);

    // restore the network to how we found it.
    CuriePME_endSaveMode();

    return 0;
}

// mark --save and restore network--

// save and restore knowledge
void CuriePME_beginSaveMode(void)
{
    nsr_save = regRead16(NSR);

    // set save/restore mode in the NSR
    regWrite16(NSR, regRead16(NSR) | NSR_NET_MODE);
    // reset the chain to 0th neuron
    regWrite16(RSTCHAIN, 0);
}

// pass the function a structure to save data into
uint16_t CuriePME_iterateNeuronsToSave(neuronData* array)
{
    array->context = regRead16(NCR);
    for (int i = 0; i < saveRestoreSize; i++) {
        array->vector[i] = regRead16(COMP);
    }

    array->influence = regRead16(AIF);
    array->minInfluence = regRead16(MINIF);
    array->category = regRead16(CAT);

    return array->category;
}

void CuriePME_endSaveMode(void)
{
    // restore the network to how we found it.
    regWrite16(NSR, (nsr_save & ~NSR_NET_MODE));
}

void CuriePME_beginRestoreMode(void)
{
    nsr_save = regRead16(NSR);

    CuriePME_forget();
    // set save/restore mode in the NSR
    regWrite16(NSR, regRead16(NSR) | NSR_NET_MODE);
    // reset the chain to 0th neuron
    regWrite16(RSTCHAIN, 0);
}

uint16_t CuriePME_iterateNeuronsToRestore(neuronData* array)
{
    regWrite16(NCR, array->context);
    for (int i = 0; i < saveRestoreSize; i++) {
        regWrite16(COMP, array->vector[i]);
    }

    regWrite16(AIF, array->influence);
    regWrite16(MINIF, array->minInfluence);
    regWrite16(CAT, array->category);

    return 0;
}

void CuriePME_endRestoreMode(void)
{
    // restore the network to how we found it.
    regWrite16(NSR, (nsr_save & ~NSR_NET_MODE));
}

// mark -- getter and setters--
PATTERN_MATCHING_DISTANCE_MODE CuriePME_getDistanceMode(void) // L1 or LSup
{
    return (GCR_DIST & regRead16(GCR)) ? LSUP_Distance : L1_Distance;
}

void CuriePME_setDistanceMode(PATTERN_MATCHING_DISTANCE_MODE mode) // L1 or LSup
{
    uint16_t rd = regRead16(GCR);

    // do a read modify write on the GCR register
    regWrite16(GCR, (mode == LSUP_Distance) ? rd | GCR_DIST : rd & ~GCR_DIST);
}

uint16_t CuriePME_getGlobalContext(void)
{
    return (GCR_GLOBAL & regRead16(GCR));
}

// A valid context value is in the range of 1-127. A context
// value of 0 enables all neurons, without regard to their context
void CuriePME_setGlobalContext(uint16_t context)
{
    uint16_t gcrMask = ~GCR_GLOBAL & regRead16(GCR);
    gcrMask |= (context & GCR_GLOBAL);
    regWrite16(GCR, gcrMask);
}

uint16_t CuriePME_getNeuronContext(void)
{
    return (NCR_CONTEXT & regRead16(NCR));
}

// valid range is 1-127
void CuriePME_setNeuronContext(uint16_t context)
{
    uint16_t ncrMask = ~NCR_CONTEXT & regRead16(NCR);
    ncrMask |= (context & NCR_CONTEXT);
    regWrite16(NCR, ncrMask);
}

// NOTE: getCommittedCount() will give inaccurate value if the network is in
// Save/Restore mode.
// It should not be called between the beginSaveMode() and endSaveMode() or
// between
// beginRestoreMode() and endRestoreMode()
uint16_t CuriePME_getCommittedCount(void)
{
    return (getFORGET_NCOUNT() & 0xff);
}

PATTERN_MATCHING_CLASSIFICATION_MODE CuriePME_getClassifierMode(void) // RBF or KNN
{
    if (regRead16(NSR) & NSR_CLASS_MODE)
        return KNN_Mode;

    return RBF_Mode;
}

void CuriePME_setClassifierMode(PATTERN_MATCHING_CLASSIFICATION_MODE mode)
{
    uint16_t mask = regRead16(NSR);
    mask &= ~NSR_CLASS_MODE;

    if (mode == KNN_Mode)
        mask |= NSR_CLASS_MODE;

    regWrite16(NSR, mask);
}

// mark --register access--
// getter and setters
uint16_t getNCR(void) { return regRead16(NCR); }

uint16_t getCOMP(void) { return regRead16(COMP); }

uint16_t getLCOMP(void) { return regRead16(LCOMP); }

uint16_t getIDX_DIST(void) { return regRead16(IDX_DIST); }

uint16_t getCAT(void) { return regRead16(CAT); }

uint16_t getAIF(void) { return regRead16(AIF); }

uint16_t getMINIF(void) { return regRead16(MINIF); }

uint16_t getMAXIF(void) { return regRead16(MAXIF); }

uint16_t getNID(void) { return regRead16(NID); }

uint16_t getGCR(void) { return regRead16(GCR); }

uint16_t getRSTCHAIN(void) { return regRead16(RSTCHAIN); }

uint16_t getNSR(void) { return regRead16(NSR); }

uint16_t getFORGET_NCOUNT(void) { return regRead16(FORGET_NCOUNT); }
```

## src/CuriePME.h
```c
// Copyright (c) 2017, Intel Corporation.

#ifndef _CURIE_PME_H_
#define _CURIE_PME_H_

#include <stdint.h>

static const uint32_t noMatch = 0x7fff;
static const uint16_t minContext = 0;
static const uint16_t maxContext = 127;
static const int32_t maxVectorSize = 128;
static const int32_t firstNeuronID = 1;
static const int32_t lastNeuronID = 128;
static const int32_t maxNeurons = 128;
static const int32_t saveRestoreSize = 128;

typedef enum {
    RBF_Mode = 0,
    KNN_Mode = 1
} PATTERN_MATCHING_CLASSIFICATION_MODE;

typedef enum {
    L1_Distance = 0,
    LSUP_Distance = 1
} PATTERN_MATCHING_DISTANCE_MODE;

typedef struct neuronData {
    uint16_t context;
    uint16_t influence;
    uint16_t minInfluence;
    uint16_t category;
    uint8_t vector[128];
} neuronData;

// Default initializer
void CuriePME_begin(void);

void CuriePME_forget(void);

void CuriePME_configure(uint16_t global_context,
                        PATTERN_MATCHING_DISTANCE_MODE distance_mode,
                        PATTERN_MATCHING_CLASSIFICATION_MODE classification_mode,
                        uint16_t minAIF,
                        uint16_t maxAIF);

uint16_t CuriePME_learn(uint8_t* pattern_vector,
                        int32_t vector_length,
                        uint16_t category);
uint16_t CuriePME_classify(uint8_t* pattern_vector, int32_t vector_length);

uint16_t CuriePME_readNeuron(int32_t neuronID, neuronData* data_array);

// save and restore knowledge
void CuriePME_beginSaveMode(void); // saves the contents of the NSR register
uint16_t CuriePME_iterateNeuronsToSave(neuronData* data_array);
void CuriePME_endSaveMode(void); // restores the NSR value saved by beginSaveMode

void CuriePME_beginRestoreMode(void);
uint16_t CuriePME_iterateNeuronsToRestore(neuronData* data_array);
void CuriePME_endRestoreMode(void);

// getter and setters
PATTERN_MATCHING_DISTANCE_MODE CuriePME_getDistanceMode(void);
void CuriePME_setDistanceMode(PATTERN_MATCHING_DISTANCE_MODE mode);
uint16_t CuriePME_getGlobalContext(void);
void CuriePME_setGlobalContext(uint16_t context); // valid range is 1-127
uint16_t CuriePME_getNeuronContext(void);
void CuriePME_setNeuronContext(uint16_t context); // valid range is 1-127

// NOTE: getCommittedCount() will give inaccurate value if the network is in
// Save/Restore mode.
// It should not be called between the beginSaveMode() and endSaveMode() or
// between
// beginRestoreMode() and endRestoreMode()
uint16_t CuriePME_getCommittedCount(void);

PATTERN_MATCHING_CLASSIFICATION_MODE CuriePME_getClassifierMode(void); // RBF or KNN
void CuriePME_setClassifierMode(PATTERN_MATCHING_CLASSIFICATION_MODE mode);

// write vector is used for kNN recognition and does not alter
// the CAT register, which moves the chain along.
uint16_t CuriePME_writeVector(uint8_t* pattern_vector, int32_t vector_length);

// raw register access - not recommended.
uint16_t getNCR(void);
uint16_t getCOMP(void);
uint16_t getLCOMP(void);
uint16_t getIDX_DIST(void);
uint16_t getCAT(void);
uint16_t getAIF(void);
uint16_t getMINIF(void);
uint16_t getMAXIF(void);
uint16_t getNID(void);
uint16_t getGCR(void);
uint16_t getRSTCHAIN(void);
uint16_t getNSR(void);
uint16_t getFORGET_NCOUNT(void);

// base address of the pattern matching accelerator in Intel(r) Curie(tm) and
// QuarkSE(tm)
static const uint32_t baseAddress = 0xB0600000L;

typedef enum {
    NCR = 0x00, // Neuron Context Register
    COMP = 0x04, // Component Register
    LCOMP = 0x08, // Last Component
    IDX_DIST = 0x0C, // Write Component Index / Read Distance
    CAT = 0x10, // Category Register
    AIF = 0x14, // Active Influence Field
    MINIF = 0x18, // Minimum Influence Field
    MAXIF = 0x1C, // Maximum Influence Field
    TESTCOMP = 0x20, // Write Test Component
    TESTCAT = 0x24, // Write Test Category
    NID = 0x28, // Network ID
    GCR = 0x2C, // Global Context Register
    RSTCHAIN = 0x30, // Reset Chain
    NSR = 0x34, // Network Status Register
    FORGET_NCOUNT = 0x3C // Forget Command / Neuron Count
} Registers;

typedef enum {
    NCR_ID = 0xFF00, // Upper 8-bit of Neuron ID
    NCR_NORM = 0x0040, // 1 = LSUP, 0 = L1
    NCR_CONTEXT = 0x007F, // Neuron Context
    CAT_DEGEN = 0x8000, // Indicates neuron is degenerate
    CAT_CATEGORY = 0x7FFF, // the category associated with a neuron
    GCR_DIST = 0x0080, // distance type, 1 = Lsup, 0 = L1
    GCR_GLOBAL = 0x007F, // the context of the neuron, used to segment the network
    NSR_CLASS_MODE = 0x0020, // Classifier mode 1 = KNN, 0 = RBF (KNN not for learning mode)
    NSR_NET_MODE = 0x0010, // 1 = SR (save/restore) 0 = LR (learn/recognize)
    NSR_ID_FLAG = 0x0008, // Indicates positive identification
    NSR_UNCERTAIN_FLAG = 0x0004, // Indicates uncertain identification
} Masks;

// all pattern matching accelerator registers are 16-bits wide, memory-addressed
// define efficient inline register access
inline volatile uint16_t* regAddress(Registers reg)
{
    return (uint16_t*)(0xB0600000L + reg);
}

inline uint16_t regRead16(Registers reg) { return *regAddress(reg); }

inline void regWrite16(Registers reg, uint16_t value)
{
    *regAddress(reg) = value;
}
#if 0
inline void regWrite16 (Registers reg, uint8_t value)
{
	*regAddress(reg) = value;
}

inline void regWrite16 (Registers reg, int value)
{
	*regAddress(reg) = value;
}
#endif
#endif
```

## src/arc_aio.c
```c
// Copyright (c) 2017-2018, Intel Corporation.

// Zephyr includes
#include <adc.h>
#include <kernel.h>
#include <zephyr.h>

// ZJS includes
#include "arc_aio.h"
#include "arc_common.h"

// AIO
static struct device *adc_dev = NULL;
static u8_t pin_enabled[AIO_LEN] = {};
static u32_t pin_values[AIO_LEN] = {};
static u32_t pin_last_values[AIO_LEN] = {};
static u8_t seq_buffer[ADC_BUFFER_SIZE];
static void *pin_user_data[AIO_LEN] = {};
static u8_t pin_send_updates[AIO_LEN] = {};

void arc_aio_init()
{
    adc_dev = device_get_binding(ADC_DEVICE_NAME);
    adc_enable(adc_dev);
}

void arc_aio_cleanup()
{
    adc_disable(adc_dev);
}

u32_t arc_pin_read(u8_t pin)
{
    struct adc_seq_entry entry = {
        .sampling_delay = 30,  // anything smaller might give an error
        .channel_id = pin,
        .buffer = seq_buffer,
        .buffer_length = ADC_BUFFER_SIZE,
    };

    struct adc_seq_table entry_table = {
        .entries = &entry,
        .num_entries = 1,
    };

    if (!adc_dev) {
        ERR_PRINT("ADC device not found\n");
        return 0;
    }

    if (adc_read(adc_dev, &entry_table) != 0) {
        ERR_PRINT("couldn't read from pin %d\n", pin);
        return 0;
    }

    // read from buffer, not sure if byte order is important
    u32_t raw_value = (u32_t)seq_buffer[0] | (u32_t)seq_buffer[1] << 8;

    return raw_value;
}

void arc_process_aio_updates()
{
    for (int i = 0; i <= 5; i++) {
        if (pin_send_updates[i]) {
            pin_values[i] = arc_pin_read(AIO_MIN + i);
            if (pin_values[i] != pin_last_values[i]) {
                // send updates only if value has changed
                // so it doesn't flood the IPM channel
                struct zjs_ipm_message msg;
                msg.id = MSG_ID_AIO;
                msg.type = TYPE_AIO_PIN_EVENT_VALUE_CHANGE;
                msg.flags = 0;
                msg.user_data = pin_user_data[i];
                msg.data.aio.pin = AIO_MIN + i;
                msg.data.aio.value = pin_values[i];
                ipm_send_msg(&msg);
                pin_last_values[i] = pin_values[i];
            }
        }
    }
}

void arc_handle_aio(struct zjs_ipm_message *msg)
{
    u32_t pin = msg->data.aio.pin;
    u32_t reply_value = 0;
    u32_t error_code = ERROR_IPM_NONE;

    if (pin < AIO_MIN || pin > AIO_MAX) {
        ERR_PRINT("pin #%u out of range\n", pin);
        ipm_send_error(msg, ERROR_IPM_INVALID_PARAMETER);
        return;
    }

    switch (msg->type) {
    case TYPE_AIO_OPEN:
        pin_enabled[pin - AIO_MIN] = 1;
        break;
    case TYPE_AIO_PIN_READ:
        reply_value = arc_pin_read(pin);
        break;
    case TYPE_AIO_PIN_ABORT:
        // NO OP - always success
        break;
    case TYPE_AIO_PIN_CLOSE:
        pin_enabled[pin - AIO_MIN] = 0;
        break;
    case TYPE_AIO_PIN_SUBSCRIBE:
        pin_send_updates[pin - AIO_MIN] = 1;
        // save user data from subscribe request and return it in change msgs
        pin_user_data[pin - AIO_MIN] = msg->user_data;
        break;
    case TYPE_AIO_PIN_UNSUBSCRIBE:
        pin_send_updates[pin - AIO_MIN] = 0;
        pin_user_data[pin - AIO_MIN] = NULL;
        break;
    default:
        ERR_PRINT("unsupported aio message type %u\n", msg->type);
        error_code = ERROR_IPM_NOT_SUPPORTED;
    }

    if (error_code != ERROR_IPM_NONE) {
        ipm_send_error(msg, error_code);
        return;
    }

    msg->data.aio.pin = pin;
    msg->data.aio.value = reply_value;
    ipm_send_msg(msg);
}
```

## src/arc_aio.h
```c
// Copyright (c) 2017, Intel Corporation.

#ifndef __arc_aio_h__
#define __arc_aio_h__

// ZJS includes
#include "zjs_ipm.h"

void arc_aio_init();

void arc_aio_cleanup();

u32_t arc_pin_read(u8_t pin);

void arc_process_aio_updates();

void arc_handle_aio(struct zjs_ipm_message *msg);

#endif  // __arc_aio_h__
```

## src/arc_common.h
```c
// Copyright (c) 2017, Intel Corporation.

#ifndef __arc_common_h__
#define __arc_common_h__

#include "zjs_common.h"
#include "zjs_ipm.h"

int ipm_send_msg(struct zjs_ipm_message *msg);

int ipm_send_error(struct zjs_ipm_message *msg, u32_t error_code);

#endif  // __arc_common_h__
```

## src/arc_curie_pme.c
```c
// Copyright (c) 2017, Intel Corporation.

#include "arc_curie_pme.h"

static u16_t nsr_save = 0;

// Default initializer
void curie_pme_begin(void)
{
    u16_t saved_nsr = reg_read16(NSR);
    curie_pme_forget();

    reg_write16(NSR, (u16_t)NSR_NET_MODE);

    for (int i = 0; i < MAX_NEURONS; i++) {
        reg_write16(TESTCOMP, 0);
    }

    reg_write16(TESTCAT, 0);
    reg_write16(NSR, saved_nsr);
}

void curie_pme_configure(u16_t global_context, PME_DISTANCE_MODE distance_mode,
                         PME_CLASSIFICATION_MODE classification_mode,
                         u16_t min_if, u16_t max_if)
{
    curie_pme_set_distance_mode(distance_mode);
    curie_pme_set_classifier_mode(classification_mode);
    reg_write16(MINIF, min_if);
    reg_write16(MAXIF, max_if);
}

// clear all commits in the network and make it ready to learn
void curie_pme_forget(void)
{
    reg_write16(FORGET_NCOUNT, 0);
}

// mark --learn and classify--
u16_t curie_pme_learn(u8_t *pattern_vector, s32_t vector_length,
                      u16_t category)
{
    if (vector_length > MAX_VECTOR_SIZE)
        vector_length = MAX_VECTOR_SIZE;

    for (int i = 0; i < vector_length - 1; i++) {
        reg_write16(COMP, pattern_vector[i]);
    }

    reg_write16(LCOMP, pattern_vector[vector_length - 1]);

    // Mask off the 15th bit-- valid categories range from 1-32766,
    // and bit 15 is used to indicate if a firing neuron has degenerated
    reg_write16(CAT, (reg_read16(CAT) & ~CAT_CATEGORY) |
                     (category & CAT_CATEGORY));

    return reg_read16(FORGET_NCOUNT);
}

u16_t curie_pme_classify(u8_t *pattern_vector, s32_t vector_length)
{
    u8_t *current_vector = pattern_vector;

    if (vector_length > MAX_VECTOR_SIZE)
        return -1;

    for (u8_t index = 0; index < (vector_length - 1); index++) {
        reg_write16(COMP, current_vector[index]);
    }

    reg_write16(LCOMP, current_vector[vector_length - 1]);
    reg_read16(IDX_DIST);

    return (reg_read16(CAT) & CAT_CATEGORY);
}

// write vector is used for kNN recognition and does not alter
// the CAT register, which moves the chain along.
u16_t curie_pme_write_vector(u8_t *pattern_vector, s32_t vector_length)
{
    u8_t *current_vector = pattern_vector;
    u8_t index = 0;

    if (vector_length > MAX_VECTOR_SIZE)
        return -1;

    for (index = 0; index < (vector_length - 1); index++) {
        reg_write16(COMP, current_vector[index]);
    }

    reg_write16(LCOMP, current_vector[vector_length - 1]);

    return 0;
}

// retrieve the data of a specific neuron element by ID, between 1 and 128.
u16_t curie_pme_read_neuron(s32_t neuron_id, neuron_data_t *data_array)
{
    u16_t dummy = 0;

    // range check the id - technically, this should be an error.

    if (neuron_id < FIRST_NEURON_ID)
        neuron_id = FIRST_NEURON_ID;
    if (neuron_id > LAST_NEURON_ID)
        neuron_id = LAST_NEURON_ID;

    // use the begin_save_mode method
    curie_pme_begin_save_mode();

    // iterate over n elements in order to reach the one we want.
    for (int i = 0; i < (neuron_id - 1); i++) {
        dummy = reg_read16(CAT);
    }

    // retrieve the data using the iterateToSave method
    curie_pme_iterate_neurons_to_save(data_array);

    // restore the network to how we found it.
    curie_pme_end_save_mode();

    return 0;
}

// mark --save and restore network--

// save and restore knowledge
void curie_pme_begin_save_mode(void)
{
    nsr_save = reg_read16(NSR);

    // set save/restore mode in the NSR
    reg_write16(NSR, reg_read16(NSR) | NSR_NET_MODE);
    // reset the chain to 0th neuron
    reg_write16(RSTCHAIN, 0);
}

// pass the function a structure to save data into
u16_t curie_pme_iterate_neurons_to_save(neuron_data_t *array)
{
    array->context = reg_read16(NCR);
    for (int i = 0; i < SAVE_RESTORE_SIZE; i++) {
        array->vector[i] = reg_read16(COMP);
    }

    array->aif = reg_read16(AIF);
    array->min_if = reg_read16(MINIF);
    array->category = reg_read16(CAT);

    return array->category;
}

void curie_pme_end_save_mode(void)
{
    // restore the network to how we found it.
    reg_write16(NSR, (nsr_save & ~NSR_NET_MODE));
}

void curie_pme_begin_restore_mode(void)
{
    nsr_save = reg_read16(NSR);

    curie_pme_forget();
    // set save/restore mode in the NSR
    reg_write16(NSR, reg_read16(NSR) | NSR_NET_MODE);
    // reset the chain to 0th neuron
    reg_write16(RSTCHAIN, 0);
}

u16_t curie_pme_iterate_neurons_to_restore(neuron_data_t *array)
{
    reg_write16(NCR, array->context);
    for (int i = 0; i < SAVE_RESTORE_SIZE; i++) {
        reg_write16(COMP, array->vector[i]);
    }

    reg_write16(AIF, array->aif);
    reg_write16(MINIF, array->min_if);
    reg_write16(CAT, array->category);

    return 0;
}

void curie_pme_end_restore_mode(void)
{
    // restore the network to how we found it.
    reg_write16(NSR, (nsr_save & ~NSR_NET_MODE));
}

PME_DISTANCE_MODE curie_pme_get_distance_mode(void)
{
    return (GCR_DIST & reg_read16(GCR)) ? LSUP_DISTANCE : L1_DISTANCE;
}

void curie_pme_set_distance_mode(PME_DISTANCE_MODE mode)
{
    u16_t rd = reg_read16(GCR);

    // do a read modify write on the GCR register
    reg_write16(GCR, (mode == LSUP_DISTANCE) ? rd | GCR_DIST : rd & ~GCR_DIST);
}

u16_t curie_pme_get_global_context(void)
{
    return (GCR_GLOBAL & reg_read16(GCR));
}

// A valid context value is in the range of 1-127. A context
// value of 0 enables all neurons, without regard to their context
void curie_pme_set_global_context(u16_t context)
{
    u16_t gcr_mask = ~GCR_GLOBAL & reg_read16(GCR);
    gcr_mask |= (context & GCR_GLOBAL);
    reg_write16(GCR, gcr_mask);
}

u16_t curie_pme_get_neuron_context(void)
{
    return (NCR_CONTEXT & reg_read16(NCR));
}

// valid range is 1-127
void curie_pme_set_neuron_context(u16_t context)
{
    u16_t ncr_mask = ~NCR_CONTEXT & reg_read16(NCR);
    ncr_mask |= (context & NCR_CONTEXT);
    reg_write16(NCR, ncr_mask);
}

u16_t curie_pme_get_committed_count(void)
{
    return (getFORGET_NCOUNT() & 0xff);
}

PME_CLASSIFICATION_MODE curie_pme_get_classifier_mode(void)
{
    if (reg_read16(NSR) & NSR_CLASS_MODE)
        return KNN_MODE;

    return RBF_MODE;
}

void curie_pme_set_classifier_mode(PME_CLASSIFICATION_MODE mode)
{
    u16_t mask = reg_read16(NSR);
    mask &= ~NSR_CLASS_MODE;

    if (mode == KNN_MODE)
        mask |= NSR_CLASS_MODE;

    reg_write16(NSR, mask);
}
```

## src/arc_curie_pme.h
```c
// Copyright (c) 2017-2018, Intel Corporation.

#ifndef _ARC_CURIE_PME_H_
#define _ARC_CURIE_PME_H_

// Zephyr includes
#include <zephyr/types.h>

static const u32_t NO_MATCH = 0x7fff;
static const u16_t MIN_CONTEXT = 0;
static const u16_t MAX_CONTEXT = 127;
static const s32_t MAX_VECTOR_SIZE = 128;
static const s32_t FIRST_NEURON_ID = 1;
static const s32_t LAST_NEURON_ID = 128;
static const s32_t MAX_NEURONS = 128;
static const s32_t SAVE_RESTORE_SIZE = 128;

typedef enum {
    RBF_MODE = 0,
    KNN_MODE = 1
} PME_CLASSIFICATION_MODE;

typedef enum {
    L1_DISTANCE = 0,
    LSUP_DISTANCE = 1
} PME_DISTANCE_MODE;

typedef struct neuron_data {
    u16_t context;
    u16_t aif;
    u16_t min_if;
    u16_t category;
    u8_t vector[128];
} neuron_data_t;

// Default initializer
void curie_pme_begin(void);

void curie_pme_forget(void);

void curie_pme_configure(u16_t global_context,
                         PME_DISTANCE_MODE distance_mode,
                         PME_CLASSIFICATION_MODE classification_mode,
                         u16_t min_if,
                         u16_t max_if);

u16_t curie_pme_learn(u8_t *pattern_vector,
                      s32_t vector_length,
                      u16_t category);
u16_t curie_pme_classify(u8_t *pattern_vector, s32_t vector_length);

u16_t curie_pme_read_neuron(s32_t neuron_id, neuron_data_t *data_array);

// save and restore knowledge
void curie_pme_begin_save_mode(void);
u16_t curie_pme_iterate_neurons_to_save(neuron_data_t *data_array);
void curie_pme_end_save_mode(void);

void curie_pme_begin_restore_mode(void);
u16_t curie_pme_iterate_neurons_to_restore(neuron_data_t *data_array);
void curie_pme_end_restore_mode(void);

// getter and setters
PME_DISTANCE_MODE curie_pme_get_distance_mode(void);
void curie_pme_set_distance_mode(PME_DISTANCE_MODE mode);
u16_t curie_pme_get_global_context(void);
void curie_pme_set_global_context(u16_t context);  // valid range is 1-127
u16_t curie_pme_get_neuron_context(void);
void curie_pme_set_neuron_context(u16_t context);  // valid range is 1-127

// NOTE: get_committed_count() will give inaccurate value if the network is in
// Save/Restore mode.
// It should not be called between the begin_save_mode() and end_save_mode() or
// between
// begin_restore_mode() and end_restore_mode()
u16_t curie_pme_get_committed_count(void);

PME_CLASSIFICATION_MODE curie_pme_get_classifier_mode(void);
void curie_pme_set_classifier_mode(PME_CLASSIFICATION_MODE mode);

// write vector is used for kNN recognition and does not alter
// the CAT register, which moves the chain along.
u16_t curie_pme_write_vector(u8_t *pattern_vector, s32_t vector_length);

// base address of the pattern matching accelerator in Intel(r) Curie(tm) and
// QuarkSE(tm)
static const u32_t baseAddress = 0xB0600000L;

typedef enum {
    NCR = 0x00,           // Neuron Context Register
    COMP = 0x04,          // Component Register
    LCOMP = 0x08,         // Last Component
    IDX_DIST = 0x0C,      // Write Component Index / Read Distance
    CAT = 0x10,           // Category Register
    AIF = 0x14,           // Active Influence Field
    MINIF = 0x18,         // Minimum Influence Field
    MAXIF = 0x1C,         // Maximum Influence Field
    TESTCOMP = 0x20,      // Write Test Component
    TESTCAT = 0x24,       // Write Test Category
    NID = 0x28,           // Network ID
    GCR = 0x2C,           // Global Context Register
    RSTCHAIN = 0x30,      // Reset Chain
    NSR = 0x34,           // Network Status Register
    FORGET_NCOUNT = 0x3C  // Forget Command / Neuron Count
} registers_t;

typedef enum {
    NCR_ID = 0xFF00,              // Upper 8-bit of Neuron ID
    NCR_NORM = 0x0040,            // 1 = LSUP, 0 = L1
    NCR_CONTEXT = 0x007F,         // Neuron Context
    CAT_DEGEN = 0x8000,           // Indicates neuron is degenerate
    CAT_CATEGORY = 0x7FFF,        // the category associated with a neuron
    GCR_DIST = 0x0080,            // distance type, 1 = Lsup, 0 = L1
    GCR_GLOBAL = 0x007F,          // the context of the neuron
    NSR_CLASS_MODE = 0x0020,      // Classifier mode 1 = KNN, 0 = RBF
    NSR_NET_MODE = 0x0010,        // 1 = save/restore 0 = learn/recognize
    NSR_ID_FLAG = 0x0008,         // Indicates positive identification
    NSR_UNCERTAIN_FLAG = 0x0004,  // Indicates uncertain identification
} Masks;

// all pattern matching accelerator registers are 16-bits wide, memory-addressed
// define efficient inline register access
inline volatile u16_t *reg_address(registers_t reg)
{
    return (u16_t *)(0xB0600000L + reg);
}

inline u16_t reg_read16(registers_t reg)
{
    return *reg_address(reg);
}

inline void reg_write16(registers_t reg, u16_t value)
{
    *reg_address(reg) = value;
}

// raw register access - not recommended.
inline u16_t getNCR(void) { return reg_read16(NCR); }
inline u16_t getCOMP(void) { return reg_read16(COMP); }
inline u16_t getLCOMP(void) { return reg_read16(LCOMP); }
inline u16_t getIDX_DIST(void) { return reg_read16(IDX_DIST); }
inline u16_t getCAT(void) { return reg_read16(CAT); }
inline u16_t getAIF(void) { return reg_read16(AIF); }
inline u16_t getMINIF(void) { return reg_read16(MINIF); }
inline u16_t getMAXIF(void) { return reg_read16(MAXIF); }
inline u16_t getNID(void) { return reg_read16(NID); }
inline u16_t getGCR(void) { return reg_read16(GCR); }
inline u16_t getRSTCHAIN(void) { return reg_read16(RSTCHAIN); }
inline u16_t getNSR(void) { return reg_read16(NSR); }
inline u16_t getFORGET_NCOUNT(void) { return reg_read16(FORGET_NCOUNT); }

#endif
```

## src/arc_grove_lcd.c
```c
// Copyright (c) 2017, Intel Corporation.

// Zephyr includes
#include <device.h>
#include <display/grove_lcd.h>
#include <string.h>
#include <zephyr.h>

// ZJS includes
#include "arc_common.h"
#include "arc_grove_lcd.h"

#define MAX_BUFFER_SIZE 256

static struct device *glcd = NULL;
static char str[MAX_BUFFER_SIZE];

void arc_handle_glcd(struct zjs_ipm_message *msg)
{
    char *buffer;
    u8_t r, g, b;
    u32_t error_code = ERROR_IPM_NONE;

    if (msg->type != TYPE_GLCD_INIT && !glcd) {
        ERR_PRINT("Grove LCD device not found\n");
        ipm_send_error(msg, ERROR_IPM_OPERATION_FAILED);
        return;
    }

    switch (msg->type) {
    case TYPE_GLCD_INIT:
        if (!glcd) {
            /* Initialize the Grove LCD */
            glcd = device_get_binding(GROVE_LCD_NAME);

            if (!glcd) {
                error_code = ERROR_IPM_OPERATION_FAILED;
            } else {
                DBG_PRINT("Grove LCD initialized\n");
            }
        }
        break;
    case TYPE_GLCD_PRINT:
        /* print to LCD screen */
        buffer = msg->data.glcd.buffer;
        if (!buffer) {
            error_code = ERROR_IPM_INVALID_PARAMETER;
            ERR_PRINT("buffer not found\n");
        } else {
            snprintf(str, MAX_BUFFER_SIZE, "%s", buffer);
            glcd_print(glcd, str, strlen(str));
            DBG_PRINT("Grove LCD print: %s\n", str);
        }
        break;
    case TYPE_GLCD_CLEAR:
        glcd_clear(glcd);
        break;
    case TYPE_GLCD_SET_CURSOR_POS:
        glcd_cursor_pos_set(glcd, msg->data.glcd.col, msg->data.glcd.row);
        break;
    case TYPE_GLCD_SET_COLOR:
        r = msg->data.glcd.color_r;
        g = msg->data.glcd.color_g;
        b = msg->data.glcd.color_b;
        glcd_color_set(glcd, r, g, b);
        break;
    case TYPE_GLCD_SELECT_COLOR:
        glcd_color_select(glcd, msg->data.glcd.value);
        break;
    case TYPE_GLCD_SET_FUNCTION:
        glcd_function_set(glcd, msg->data.glcd.value);
        break;
    case TYPE_GLCD_GET_FUNCTION:
        msg->data.glcd.value = glcd_function_get(glcd);
        break;
    case TYPE_GLCD_SET_DISPLAY_STATE:
        glcd_display_state_set(glcd, msg->data.glcd.value);
        break;
    case TYPE_GLCD_GET_DISPLAY_STATE:
        msg->data.glcd.value = glcd_display_state_get(glcd);
        break;
    case TYPE_GLCD_SET_INPUT_STATE:
        glcd_input_state_set(glcd, msg->data.glcd.value);
        break;
    case TYPE_GLCD_GET_INPUT_STATE:
        msg->data.glcd.value = glcd_input_state_get(glcd);
        break;
    default:
        ERR_PRINT("unsupported grove lcd message type %u\n", msg->type);
        error_code = ERROR_IPM_NOT_SUPPORTED;
    }

    if (error_code != ERROR_IPM_NONE) {
        ipm_send_error(msg, error_code);
        return;
    }

    ipm_send_msg(msg);
}
```

## src/arc_grove_lcd.h
```c
// Copyright (c) 2017, Intel Corporation.

#ifndef __arc_grove_lcd_h__
#define __arc_grove_lcd_h__

void arc_handle_glcd(struct zjs_ipm_message *msg);

#endif  // __arc_grove_lcd_h__
```

## src/arc_i2c.c
```c
// Copyright (c) 2017, Intel Corporation.

// Zephyr includes
#include <i2c.h>
#include <zephyr.h>

// ZJS includes
#include "arc_common.h"
#include "arc_i2c.h"
#include "zjs_i2c_handler.h"

#define MAX_I2C_BUS 2

void arc_handle_i2c(struct zjs_ipm_message *msg)
{
    u32_t error_code = ERROR_IPM_NONE;
    u8_t msg_bus = msg->data.i2c.bus;

    switch (msg->type) {
    case TYPE_I2C_OPEN:
        error_code = zjs_i2c_handle_open(msg_bus);
        break;
    case TYPE_I2C_WRITE:
        error_code = zjs_i2c_handle_write(msg_bus, msg->data.i2c.data,
                                          msg->data.i2c.length,
                                          msg->data.i2c.address);
        break;
    case TYPE_I2C_WRITE_BIT:
        DBG_PRINT("received TYPE_I2C_WRITE_BIT\n");
        break;
    case TYPE_I2C_READ:
        error_code = zjs_i2c_handle_read(msg_bus, msg->data.i2c.data,
                                         msg->data.i2c.length,
                                         msg->data.i2c.address);
        break;
    case TYPE_I2C_BURST_READ:
        error_code = zjs_i2c_handle_burst_read(msg_bus, msg->data.i2c.data,
                                               msg->data.i2c.length,
                                               msg->data.i2c.address,
                                               msg->data.i2c.register_addr);
        break;
    case TYPE_I2C_TRANSFER:
        DBG_PRINT("received TYPE_I2C_TRANSFER\n");
        break;
    default:
        ERR_PRINT("unsupported i2c message type %u\n", msg->type);
        error_code = ERROR_IPM_NOT_SUPPORTED;
    }

    if (error_code != ERROR_IPM_NONE) {
        ipm_send_error(msg, error_code);
        return;
    }

    ipm_send_msg(msg);
}
```

## src/arc_i2c.h
```c
// Copyright (c) 2017, Intel Corporation.

#ifndef __arc_i2c_h__
#define __arc_i2c_h__

void arc_handle_i2c(struct zjs_ipm_message *msg);

#endif  // __arc_i2c_h__
```

## src/arc_pme.c
```c
// Copyright (c) 2017-2018, Intel Corporation.

// C includes
#include <string.h>

// Zephyr includes
#include <zephyr.h>

// ZJS includes
#include "arc_common.h"
#include "arc_curie_pme.h"
#include "arc_pme.h"

#ifdef BUILD_MODULE_PME
static bool save_mode = false;
static bool restore_mode = false;
#endif

void arc_handle_pme(struct zjs_ipm_message *msg)
{
    u32_t error_code = ERROR_IPM_NONE;

    switch (msg->type) {
    case TYPE_PME_BEGIN:
        curie_pme_begin();
        break;
    case TYPE_PME_FORGET:
        curie_pme_forget();
        break;
    case TYPE_PME_CONFIGURE:
        // valid range is 1-127
        if (msg->data.pme.g_context < 1 || msg->data.pme.g_context > 127) {
            ERR_PRINT("context range has to be 1-127\n");
            ipm_send_error(msg, ERROR_IPM_INVALID_PARAMETER);
            return;
        }

        if (msg->data.pme.c_mode != RBF_MODE &&
            msg->data.pme.c_mode != KNN_MODE) {
            ERR_PRINT("invalid classifier mode\n");
            ipm_send_error(msg, ERROR_IPM_INVALID_PARAMETER);
            return;
        }

        if (msg->data.pme.d_mode != L1_DISTANCE &&
            msg->data.pme.d_mode != LSUP_DISTANCE) {
            ERR_PRINT("invalid distance mode\n");
            ipm_send_error(msg, ERROR_IPM_INVALID_PARAMETER);
            return;
        }

        curie_pme_configure(msg->data.pme.g_context, msg->data.pme.d_mode,
                            msg->data.pme.c_mode, msg->data.pme.min_if,
                            msg->data.pme.max_if);
        break;
    case TYPE_PME_LEARN:
        DBG_PRINT("learning: category=%d is %lu byte vector\n",
                  msg->data.pme.category, msg->data.pme.vector_size);
        if (msg->data.pme.vector_size > MAX_VECTOR_SIZE) {
            ERR_PRINT("vector cannot be greater than %d\n", MAX_VECTOR_SIZE);
            ipm_send_error(msg, ERROR_IPM_INVALID_PARAMETER);
            return;
        }

        for (int i = 0; i < msg->data.pme.vector_size; i++) {
            DBG_PRINT("%d ", msg->data.pme.vector[i]);
        }

        curie_pme_learn(msg->data.pme.vector, msg->data.pme.vector_size,
                        msg->data.pme.category);
        DBG_PRINT("\nlearned with %d neruons\n",
                  curie_pme_get_committed_count());
        break;
    case TYPE_PME_CLASSIFY:
        DBG_PRINT("classify: %lu byte vector\n", msg->data.pme.category,
                  msg->data.pme.vector_size);
        if (msg->data.pme.vector_size > MAX_VECTOR_SIZE) {
            ERR_PRINT("vector cannot be greater than %d\n", MAX_VECTOR_SIZE);
            ipm_send_error(msg, ERROR_IPM_INVALID_PARAMETER);
            return;
        }

        for (int i = 0; i < msg->data.pme.vector_size; i++) {
            DBG_PRINT("%d ", msg->data.pme.vector[i]);
        }

        msg->data.pme.category = curie_pme_classify(msg->data.pme.vector,
                                                    msg->data.pme.vector_size);
        DBG_PRINT("\ncategory: %d\n", msg->data.pme.category);
        break;
    case TYPE_PME_READ_NEURON:
        DBG_PRINT("read: neuron id=%d\n", msg->data.pme.neuron_id);
        if (msg->data.pme.neuron_id < 1 || msg->data.pme.neuron_id > 128) {
            ERR_PRINT("invalid neuron id, must be between 1 and 128\n");
            ipm_send_error(msg, ERROR_IPM_INVALID_PARAMETER);
            return;
        }

        neuron_data_t data;
        curie_pme_read_neuron(msg->data.pme.neuron_id, &data);
        msg->data.pme.category = data.category;
        msg->data.pme.n_context = data.context;
        msg->data.pme.aif = data.aif;
        msg->data.pme.min_if = data.min_if;
        memcpy(msg->data.pme.vector, data.vector, sizeof(data.vector));
        DBG_PRINT("neuron: id=%d, CTX=%d, AIF=%d MIF=%d, cat=%d\n",
                  data.context & NCR_ID, data.context & NCR_CONTEXT, data.aif,
                  data.min_if, data.category);
        break;
    case TYPE_PME_WRITE_VECTOR:
        DBG_PRINT("write vector: %lu byte vector\n", msg->data.pme.category,
                  msg->data.pme.vector_size);
        if (msg->data.pme.vector_size > MAX_VECTOR_SIZE) {
            ERR_PRINT("vector cannot be greater than %d\n", MAX_VECTOR_SIZE);
            ipm_send_error(msg, ERROR_IPM_INVALID_PARAMETER);
            return;
        }

        if (curie_pme_get_classifier_mode() != KNN_MODE) {
            ERR_PRINT("write vector only supports KNN_MODE\n");
            ipm_send_error(msg, ERROR_IPM_INVALID_PARAMETER);
            return;
        }

        for (int i = 0; i < msg->data.pme.vector_size; i++) {
            DBG_PRINT("%d ", msg->data.pme.vector[i]);
        }

        curie_pme_write_vector(msg->data.pme.vector, msg->data.pme.vector_size);
        DBG_PRINT("\nwrote with %d neruons\n", curie_pme_get_committed_count());
        break;
    case TYPE_PME_GET_COMMITED_COUNT:
        msg->data.pme.committed_count = curie_pme_get_committed_count();
        DBG_PRINT("committed count: %d\n", msg->data.pme.committed_count);
        break;
    case TYPE_PME_GET_GLOBAL_CONTEXT:
        msg->data.pme.g_context = curie_pme_get_global_context();
        DBG_PRINT("global context: %d\n", msg->data.pme.g_context);
        break;
    case TYPE_PME_GET_CLASSIFIER_MODE:
        msg->data.pme.c_mode = curie_pme_get_classifier_mode();
        DBG_PRINT("classifier mode: %d\n", msg->data.pme.c_mode);
        break;
    case TYPE_PME_SET_CLASSIFIER_MODE:
        if (msg->data.pme.c_mode != RBF_MODE &&
            msg->data.pme.c_mode != KNN_MODE) {
            ERR_PRINT("invalid classifier mode\n");
            ipm_send_error(msg, ERROR_IPM_INVALID_PARAMETER);
            return;
        }

        curie_pme_set_classifier_mode(msg->data.pme.c_mode);
        DBG_PRINT("classifier mode: %d\n", msg->data.pme.c_mode);
        break;
    case TYPE_PME_GET_DISTANCE_MODE:
        msg->data.pme.d_mode = curie_pme_get_distance_mode();
        DBG_PRINT("distance mode: %d\n", msg->data.pme.d_mode);
        break;
    case TYPE_PME_SET_DISTANCE_MODE:
        if (msg->data.pme.d_mode != L1_DISTANCE &&
            msg->data.pme.d_mode != LSUP_DISTANCE) {
            ERR_PRINT("invalid distance mode\n");
            ipm_send_error(msg, ERROR_IPM_INVALID_PARAMETER);
            return;
        }

        curie_pme_set_distance_mode(msg->data.pme.d_mode);
        DBG_PRINT("distance mode: %d\n", msg->data.pme.d_mode);
        break;
    case TYPE_PME_BEGIN_SAVE_MODE:
        curie_pme_begin_save_mode();
        save_mode = true;
        DBG_PRINT("begin save mode\n");
        break;
    case TYPE_PME_ITERATE_TO_SAVE:
        if (!save_mode) {
            ERR_PRINT("not in save mode\n");
            ipm_send_error(msg, ERROR_IPM_OPERATION_FAILED);
        }

        curie_pme_iterate_neurons_to_save(&data);
        msg->data.pme.category = data.category;
        msg->data.pme.n_context = data.context;
        msg->data.pme.aif = data.aif;
        msg->data.pme.min_if = data.min_if;
        memcpy(msg->data.pme.vector, data.vector, sizeof(data.vector));
        DBG_PRINT("save neuron: id=%d, CTX=%d, AIF=%d MIF=%d, cat=%d\n",
                  data.context & NCR_ID, data.context & NCR_CONTEXT, data.aif,
                  data.min_if, data.category);
        break;
    case TYPE_PME_END_SAVE_MODE:
        curie_pme_end_save_mode();
        save_mode = false;
        DBG_PRINT("end save mode\n");
        break;
    case TYPE_PME_BEGIN_RESTORE_MODE:
        curie_pme_begin_restore_mode();
        restore_mode = true;
        DBG_PRINT("begin restore mode\n");
        break;
    case TYPE_PME_ITERATE_TO_RESTORE:
        if (!restore_mode) {
            ERR_PRINT("not in restore mode\n");
            ipm_send_error(msg, ERROR_IPM_OPERATION_FAILED);
        }

        data.category = msg->data.pme.category;
        data.context = msg->data.pme.n_context;
        data.aif = msg->data.pme.aif;
        data.min_if = msg->data.pme.min_if;
        memcpy(data.vector, msg->data.pme.vector, sizeof(msg->data.pme.vector));
        curie_pme_iterate_neurons_to_restore(&data);
        DBG_PRINT("restore neuron: id=%d, CTX=%d, AIF=%d MIF=%d, cat=%d\n",
                  data.context & NCR_ID, data.context & NCR_CONTEXT, data.aif,
                  data.min_if, data.category);

        break;
    case TYPE_PME_END_RESTORE_MODE:
        curie_pme_end_restore_mode();
        restore_mode = false;
        DBG_PRINT("end retore mode\n");
        break;

    default:
        ERR_PRINT("unsupported pme message type %u\n", msg->type);
        error_code = ERROR_IPM_NOT_SUPPORTED;
    }

    if (error_code != ERROR_IPM_NONE) {
        ipm_send_error(msg, error_code);
        return;
    }

    ipm_send_msg(msg);
}
```
