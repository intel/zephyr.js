## prj.conf
```kconfig
# Use standard security profile. (=> no need for a random number generator)
CONFIG_STDOUT_CONSOLE=y
CONFIG_NEWLIB_LIBC=y
CONFIG_FLOAT=y
CONFIG_GPIO=y
CONFIG_PWM=y
CONFIG_PWM_QMSI_NUM_PORTS=4
CONFIG_NANO_TIMERS=y
CONFIG_NANO_TIMEOUTS=y
CONFIG_ARC_INIT=y
CONFIG_IPM=y
CONFIG_IPM_QUARK_SE=y
CONFIG_IPM_CONSOLE_RECEIVER=y
CONFIG_BLUETOOTH=y
CONFIG_BLUETOOTH_LE=y
CONFIG_BLUETOOTH_SMP=y
CONFIG_BLUETOOTH_PERIPHERAL=y
CONFIG_BLUETOOTH_GATT_DYNAMIC_DB=y
CONFIG_ROM_SIZE=256
```

## src/main.c
```c
// Copyright (c) 2016, Intel Corporation.

// Zephyr includes
#include <zephyr.h>

#if defined(CONFIG_STDOUT_CONSOLE)
#include <stdio.h>
#define PRINT           printf
#else
#include <misc/printk.h>
#define PRINT           printk
#endif

#include <string.h>

// JerryScript includes
#include "jerry.h"
#include "jerry-api.h"

// ZJS API includes
#include "util.h"

// local includes
#include "script.h"
#include "mod_gpio.h"
#include "timers.h"

void main(int argc, char *argv[])
{
    jerry_init(JERRY_FLAG_EMPTY);

    jerry_api_object_t *global_obj = jerry_api_get_global();
    zjs_gpio_init(global_obj);

    zjs_timers_init();

    jerry_api_object_t *err_obj_p = NULL;
    size_t len = strlen((char *)script);
    jerry_parse((jerry_api_char_t *)script, len, &err_obj_p);

    jerry_run(&err_obj_p);

    while (1) {
        if (zjs_timers_process_events() == false)
            break;
    }
}
```

## src/mod_gpio.c
```c
// Copyright (c) 2016, Intel Corporation.

// Zephyr includes
#include <zephyr.h>
#include <gpio.h>
#include <misc/util.h>
#include <string.h>

#if defined(CONFIG_STDOUT_CONSOLE)
#include <stdio.h>
#define PRINT           printf
#else
#include <misc/printk.h>
#define PRINT           printk
#endif

// ZJS API includes
#include "util.h"

// local includes
#include "mod_gpio.h"

#if defined(CONFIG_GPIO_DW_0)
#define GPIO_DRV_NAME CONFIG_GPIO_DW_0_NAME
#elif defined(CONFIG_GPIO_QMSI_0)
#define GPIO_DRV_NAME CONFIG_GPIO_QMSI_0_NAME
#elif defined(CONFIG_GPIO_ATMEL_SAM3)
#define GPIO_DRV_NAME CONFIG_GPIO_ATMEL_SAM3_PORTB_DEV_NAME
#else
#error "Unsupported GPIO driver"
#endif

static const char *ZJS_DIR_IN = "in";
static const char *ZJS_DIR_OUT = "out";

static const char *ZJS_EDGE_NONE = "none";
static const char *ZJS_EDGE_RISING = "rising";
static const char *ZJS_EDGE_FALLING = "falling";
static const char *ZJS_EDGE_BOTH = "any";

static const char *ZJS_PULL_NONE = "none";
static const char *ZJS_PULL_UP = "up";
static const char *ZJS_PULL_DOWN = "down";

static struct device *zjs_gpio_dev;

// extend the gpio_callback struct to store extra data
struct zjs_gpio_callback {
    struct gpio_callback orig;
    jerry_api_object_t *js_callback;
};

static struct zjs_gpio_callback zjs_gpio_cb;

static void zjs_gpio_callback_wrapper(struct device *port,
                                      struct gpio_callback *cb,
                                      uint32_t pins)
{
    // effects: calls the JS callback registered in the struct
    struct zjs_gpio_callback *mycb = CONTAINER_OF(cb, struct zjs_gpio_callback,
                                                  orig);
    if (!mycb->js_callback) {
        PRINT("zjs_gpio_callback_wrapper: No callback registered!\n");
        return;
    }

    jerry_api_value_t rval;
    jerry_api_call_function(mycb->js_callback, NULL, &rval, NULL, 0);
}

void zjs_gpio_init(jerry_api_object_t *global_obj)
{
    // requires: global_obj is a pointer to the global JS object
    //  effects: finds the GPIO driver and registers the GPIO JS object
    zjs_gpio_dev = device_get_binding(GPIO_DRV_NAME);
    if (!zjs_gpio_dev) {
        PRINT("Cannot find %s!\n", GPIO_DRV_NAME);
    }

    // create global GPIO object
    jerry_api_object_t *gpio_obj = jerry_api_create_object();
    zjs_obj_add_object(global_obj, gpio_obj, "GPIO");
    zjs_obj_add_function(gpio_obj, zjs_gpio_open, "open");
    zjs_obj_add_function(gpio_obj, zjs_gpio_pin_write, "pin_write");
    zjs_obj_add_function(gpio_obj, zjs_gpio_set_callback, "set_callback");
}

bool zjs_gpio_open(const jerry_api_object_t *function_obj_p,
                   const jerry_api_value_t *this_p,
                   jerry_api_value_t *ret_val_p,
                   const jerry_api_value_t args_p[],
                   const jerry_api_length_t args_cnt)
{
    // requires: arg 0 is an object with these members: pin (int), direction
    //             (defaults to "out"), activeLow (defaults to false),
    //             edge (defaults to "any"), poll (default to 0, no polling),
    //             pull (default to undefined), raw (defaults to false)
    if (args_cnt < 1 ||
        args_p[0].type != JERRY_API_DATA_TYPE_OBJECT)
    {
        PRINT("zjs_gpio_open: invalid arguments\n");
        return false;
    }

    // data input object
    jerry_api_object_t *data = args_p[0].u.v_object;

    uint32_t pin;
    if (!zjs_obj_get_uint32(data, "pin", &pin)) {
        PRINT("zjs_gpio_open: missing required field\n");
        return false;
    }

    int flags = 0;
    bool dirOut = true;

    const int BUFLEN = 10;
    char buffer[BUFLEN];
    if (zjs_obj_get_string(data, "direction", buffer, BUFLEN)) {
        if (!strcmp(buffer, ZJS_DIR_IN))
            dirOut = false;
    }
    flags |= dirOut ? GPIO_DIR_OUT : GPIO_DIR_IN;

    bool activeLow = false;
    zjs_obj_get_boolean(data, "activeLow", &activeLow);
    flags |= activeLow ? GPIO_POL_INV : GPIO_POL_NORMAL;

    const char *edge = ZJS_EDGE_NONE;
    bool both = false;
    if (zjs_obj_get_string(data, "edge", buffer, BUFLEN)) {
        if (!strcmp(buffer, ZJS_EDGE_BOTH)) {
            flags |= GPIO_INT | GPIO_INT_DOUBLE_EDGE;
            edge = ZJS_EDGE_BOTH;
            both = true;
        }
        else if (!strcmp(buffer, ZJS_EDGE_RISING)) {
            // Zephyr triggers on active edge, so we need to be "active high"
            flags |= GPIO_INT | GPIO_INT_EDGE | GPIO_INT_ACTIVE_HIGH;
            edge = ZJS_EDGE_RISING;
            both = false;
        }
        else if (!strcmp(buffer, ZJS_EDGE_FALLING)) {
            // Zephyr triggers on active edge, so we need to be "active low"
            flags |= GPIO_INT | GPIO_INT_EDGE | GPIO_INT_ACTIVE_LOW;
            edge = ZJS_EDGE_FALLING;
            both = false;
        }
        // else ZJS_ASSERT(!strcmp(buffer, ZJS_EDGE_BOTH));
    }

    // NOTE: Soletta API doesn't seem to provide a way to use Zephyr's
    //   level triggering

    const char *pull = ZJS_PULL_NONE;
    if (zjs_obj_get_string(data, "pull", buffer, BUFLEN)) {
        if (!strcmp(buffer, ZJS_PULL_UP)) {
            pull = ZJS_PULL_UP;
            flags |= GPIO_PUD_PULL_UP;
        }
        else if (!strcmp(buffer, ZJS_PULL_DOWN)) {
            pull = ZJS_PULL_DOWN;
            flags |= GPIO_PUD_PULL_DOWN;
        }
        // else ZJS_ASSERT(!strcmp(buffer, ZJS_PULL_NONE))
    }
    if (pull == ZJS_PULL_NONE)
        flags |= GPIO_PUD_NORMAL;

    PRINT("DBG: Configuring pin #%lu with flags %x\n", pin, flags);
    int rval = gpio_pin_configure(zjs_gpio_dev, pin, flags);
    if (rval) {
        PRINT("error: opening GPIO pin #%lu! (%d)\n", pin, rval);
        //        return false;
    }

    // create the GPIOPin object
    jerry_api_object_t *pinobj = jerry_api_create_object();
    zjs_obj_add_function(pinobj, zjs_gpio_pin_read, "read");
    zjs_obj_add_function(pinobj, zjs_gpio_pin_write, "write");
    zjs_obj_add_function(pinobj, zjs_gpio_pin_write, "close");
    zjs_obj_add_uint32(pinobj, pin, "pin");
    zjs_obj_add_string(pinobj, dirOut ? ZJS_DIR_OUT : ZJS_DIR_IN, "direction");
    zjs_obj_add_boolean(pinobj, activeLow, "activeLow");
    zjs_obj_add_string(pinobj, edge, "edge");
    zjs_obj_add_string(pinobj, pull, "pull");

    *ret_val_p = jerry_api_create_object_value(pinobj);
    return true;
}

bool zjs_gpio_pin_read(const jerry_api_object_t *function_obj_p,
                       const jerry_api_value_t *this_p,
                       jerry_api_value_t *ret_val_p,
                       const jerry_api_value_t args_p[],
                       const jerry_api_length_t args_cnt)
{
    // requires: this_p is a GPIOPin object from zjs_gpio_open, takes no args
    //  effects: reads a logical value from the pin and returns it in ret_val_p
    jerry_api_object_t *obj = jerry_api_get_object_value(this_p);

    uint32_t pin;
    zjs_obj_get_uint32(obj, "pin", &pin);
    bool activeLow = false;
    zjs_obj_get_boolean(obj, "activeLow", &activeLow);

    uint32_t value;
    int rval = gpio_pin_read(zjs_gpio_dev, pin, &value);
    if (rval) {
        PRINT("error: reading from GPIO pin #%lu!\n", pin);
        return false;
    }

    bool logical = false;
    if ((value && !activeLow) || (!value && activeLow))
        logical = true;
    ret_val_p->type = JERRY_API_DATA_TYPE_BOOLEAN;
    ret_val_p->u.v_bool = logical;
    PRINT("DBG: Reading pin #%lu: %s (%lu)\n", pin,
          logical ? "ACTIVE":"INACTIVE", value);

    return true;
}

bool zjs_gpio_pin_write(const jerry_api_object_t *function_obj_p,
                        const jerry_api_value_t *this_p,
                        jerry_api_value_t *ret_val_p,
                        const jerry_api_value_t args_p[],
                        const jerry_api_length_t args_cnt)
{
    // requires: this_p is a GPIOPin object from zjs_gpio_open, takes one arg,
    //             the logical boolean value to set to the pin (true = active)
    //  effects: writes the logical value to the pin
    if (args_cnt < 1 ||
        args_p[0].type != JERRY_API_DATA_TYPE_BOOLEAN)
    {
        PRINT("zjs_gpio_pin_write: invalid arguments\n");
        return false;
    }

    bool logical = args_p[0].u.v_bool;

    jerry_api_object_t *obj = jerry_api_get_object_value(this_p);

    uint32_t pin;
    zjs_obj_get_uint32(obj, "pin", &pin);
    bool activeLow = false;
    zjs_obj_get_boolean(obj, "activeLow", &activeLow);

    uint32_t value = 0;
    if ((logical && !activeLow) || (!logical && activeLow))
        value = 1;
    PRINT("DBG: Setting pin #%lu to %s (%lu)\n", pin,
          logical ? "ACTIVE":"INACTIVE", value);
    int rval = gpio_pin_write(zjs_gpio_dev, pin, value);
    if (rval) {
        PRINT("error: writing to GPIO #%lu!\n", pin);
        return false;
    }

    return true;
}

bool zjs_gpio_set_callback(const jerry_api_object_t *function_obj_p,
                           const jerry_api_value_t *this_p,
                           jerry_api_value_t *ret_val_p,
                           const jerry_api_value_t args_p[],
                           const jerry_api_length_t args_cnt)
{
    // requires: first arg is pin number, second is a JS callback function
    //  effects: registers this callback to be called when the GPIO changes
    if (args_cnt < 2 ||
        args_p[0].type != JERRY_API_DATA_TYPE_FLOAT32 ||
        args_p[1].type != JERRY_API_DATA_TYPE_OBJECT)
    {
        PRINT("zjs_gpio_set_callback: invalid arguments\n");
        return false;
    }

    if (zjs_gpio_cb.js_callback) {
        PRINT("error: currently cannot set second GPIO callback!\n");
        return false;
    }

    int pin = (int)args_p[0].u.v_float32;
    zjs_gpio_cb.js_callback = args_p[1].u.v_object;
    gpio_init_callback(&zjs_gpio_cb.orig, zjs_gpio_callback_wrapper, BIT(pin));

	int rval = gpio_add_callback(zjs_gpio_dev, &zjs_gpio_cb.orig);
	if (rval) {
		PRINT("error: cannot setup callback!\n");
	}

	rval = gpio_pin_enable_callback(zjs_gpio_dev, pin);
	if (rval) {
		PRINT("error: cannot enable callback!\n");
	}

    return true;
}
```

## src/mod_gpio.h
```c
// Copyright (c) 2016, Intel Corporation.

#include "jerry-api.h"

void zjs_gpio_init(jerry_api_object_t *global_obj);

bool zjs_gpio_open(const jerry_api_object_t *function_obj_p,
                   const jerry_api_value_t *this_p,
                   jerry_api_value_t *ret_val_p,
                   const jerry_api_value_t args_p[],
                   const jerry_api_length_t args_cnt);

bool zjs_gpio_pin_read(const jerry_api_object_t *function_obj_p,
                        const jerry_api_value_t *this_p,
                        jerry_api_value_t *ret_val_p,
                        const jerry_api_value_t args_p[],
                        const jerry_api_length_t args_cnt);

bool zjs_gpio_pin_write(const jerry_api_object_t *function_obj_p,
                        const jerry_api_value_t *this_p,
                        jerry_api_value_t *ret_val_p,
                        const jerry_api_value_t args_p[],
                        const jerry_api_length_t args_cnt);

bool zjs_gpio_set_callback(const jerry_api_object_t *function_obj_p,
                           const jerry_api_value_t *this_p,
                           jerry_api_value_t *ret_val_p,
                           const jerry_api_value_t args_p[],
                           const jerry_api_length_t args_cnt);
```

## src/timers.c
```c
// Copyright (c) 2016, Intel Corporation.

#include <zephyr.h>

#if defined(CONFIG_STDOUT_CONSOLE)
#include <stdio.h>
#define PRINT           printf
#else
#include <misc/printk.h>
#define PRINT           printk
#endif

#include <string.h>

#include "jerry.h"
#include "jerry-api.h"

#include "util.h"

#define MAX_NUMBER_TIMERS 10

static struct nano_timer timer;

typedef struct {
    uint32_t interval;
    uint32_t ticks_remain;
    bool expire;
    jerry_api_object_t *callback;
} zjs_timer_t;


static zjs_timer_t zjs_timers[MAX_NUMBER_TIMERS];

static bool 
add_timer(uint32_t interval, 
          jerry_api_object_t* callback)
{
    for (int i = 0; i < MAX_NUMBER_TIMERS; i++)
    {
        zjs_timer_t *t = &zjs_timers[i];
        if (!t->callback)
        {
            // Found an empty slot.
            t->callback = callback;
            t->interval = interval;
            t->expire = false;
            t->ticks_remain = interval;
            return true;
        }
    }
    return false;
}

static bool
delete_timer(jerry_api_object_t *objPtr)
{
    PRINT ("Delete timer is called\n");
    for (int i = 0; i < MAX_NUMBER_TIMERS; i++)
    {
        zjs_timer_t *t = &zjs_timers[i];
        if (objPtr == t->callback)
        {
            PRINT ("timer found\n");
            t->callback = NULL;
            t->interval = 0;
            t->expire = false;
            t->ticks_remain = 0;
            return true;
        }
    }
    return false;
}

// native setInterval handler
static bool
native_setInterval_handler(const jerry_api_object_t * function_obj_p,
         const jerry_api_value_t * this_p,
         jerry_api_value_t * ret_val_p,
         const jerry_api_value_t args_p[],
         const jerry_api_length_t args_cnt)
{
    if (args_p[1].type != JERRY_API_DATA_TYPE_FLOAT32 ||
        args_p[0].type != JERRY_API_DATA_TYPE_OBJECT)
    {
        PRINT ("native_setInterval_handler: invalid arguments\n");
        return false;
    }

    uint32_t interval = (uint32_t)(args_p[1].u.v_float32 / 1000 *
                                   CONFIG_SYS_CLOCK_TICKS_PER_SEC);
    jerry_api_object_t *callback = args_p[0].u.v_object;

    if (!add_timer(interval, callback))
    {
        // TODO: should throw an exception
        PRINT ("Error: out of timers\n");
        return false;
    }

    zjs_init_api_value_object(ret_val_p, callback);
    return true;
}

// native setInterval handler
static bool
native_clearInterval_handler(const jerry_api_object_t * function_obj_p,
         const jerry_api_value_t * this_p,
         jerry_api_value_t * ret_val_p,
         const jerry_api_value_t args_p[],
         const jerry_api_length_t args_cnt)
{
    if (args_p[0].type != JERRY_API_DATA_TYPE_OBJECT)
    {
        PRINT ("native_setInterval_handler: invalid arguments\n");
        return false;
    }

    PRINT ("clear interval is called\n");
    jerry_api_object_t *t = args_p[0].u.v_object;

    if (!delete_timer(t))
    {
        // TODO: should throw an exception
        PRINT ("Error: timer not found\n");
        return false;
    }

    return true;
}

bool zjs_timers_process_events()
{
    int i;

    /* find the least amount of ticks remain in the list */
    uint32_t ticks = 0xffffffff;
    zjs_timer_t *t = NULL;
    for (i = 0; i < MAX_NUMBER_TIMERS; i++)
    {
        t = &zjs_timers[i];
        if (ticks > t->ticks_remain && t->ticks_remain != 0)
        {
            ticks = t->ticks_remain;
        }
    }

    if (ticks == 0xffffffff)
        return false;

    for (i = 0; i < MAX_NUMBER_TIMERS; i++)
    {
        t = &zjs_timers[i];
        t->ticks_remain = t->ticks_remain - ticks;
        if (t->ticks_remain < 1 && t->callback)
        {
            t->ticks_remain = t->interval;
            t->expire = true;
        }
    }

    // setup next timer to be expired
    nano_timer_start(&timer, ticks);
    nano_timer_test(&timer, TICKS_UNLIMITED);

    // call callbacks
    for (i = 0; i < MAX_NUMBER_TIMERS; i++)
    {
        t = &zjs_timers[i];
        if (t->expire && t->callback)
        {
            jerry_api_value_t ret_val;
            jerry_api_call_function(t->callback, NULL, &ret_val, NULL, 0);
            t->expire = false;
        }
    }

    return true;
}

void zjs_timers_init()
{
    void *timer_data[1];

    // initialize system timer
    nano_timer_init(&timer, timer_data);

    jerry_api_object_t *global_obj = jerry_api_get_global();

    // create the C handler for setInterval JS call
    zjs_obj_add_function(global_obj, native_setInterval_handler, "setInterval");

    // create the C handler for clearInterval JS call
    zjs_obj_add_function(global_obj, native_clearInterval_handler, "clearInterval");
}
```
